/************************************************** Description *******************************************************/
/*
    File : Config.cpp
    Programmer : Mohammad Lotfi
    Used : Nothing
    Design Pattern : Nothing
    Types of memory : Nothing
    Total Tread : Nothing
    Site : https://www.mahsen.ir
    Tel : +989124662703
    Email : info@mahsen.ir
    Last Update : 2024/1/30
*/
/************************************************** Warnings **********************************************************/
/*
    Nothing
*/
/************************************************** Wizards ***********************************************************/
/*
    Nothing
*/
/************************************************** Includes **********************************************************/
#include "config.hpp"
/************************************************** Defineds **********************************************************/
/*
    Nothing
*/
/************************************************** Names *************************************************************/
/*
    Nothing
*/
/************************************************** Variables *********************************************************/
/*
    Nothing
*/
/************************************************** Opjects ***********************************************************/
CONFIG Config;
/************************************************** Functions *********************************************************/
void CONFIG::Init(void) {	
	GPIO_SetDir (1, 26, GPIO_DIR_OUTPUT);
	GPIO_PinWrite (1, 26, false);
	GPIO_SetDir (3, 26, GPIO_DIR_OUTPUT);
	GPIO_PinWrite (3, 26, false);
	osDelay(200 MSec);
	
	funinit("M:");
	fsStatus f1 = finit("M:");
	if(f1 != fsOK) {
		while(true);
	}
	fsStatus f2 = fmount("M:");
	if(f2 != fsOK) {
		while(true);
	}
	
	osDelay(200 MSec);
	FILE *File_Config = fopen("Config.xml", "r");
	if(File_Config) {
		GPIO_PinWrite (1, 26, true);
	}
	else {
		while(true);
	}
}
/************************************************** Tasks *************************************************************/
/*
    Nothing
*/
/************************************************** Vectors ***********************************************************/
/*
    Nothing
*/
/**********************************************************************************************************************/
